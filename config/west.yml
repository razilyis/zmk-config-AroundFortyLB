## config/west.yml
```yaml
manifest:
  remotes:
    # DYA Studio Custom Protocol 対応モジュール
    - name: cormoran
      url-base: https://github.com/cormoran
    # RGB Widgetモジュール
    - name: caksoylar
      url-base: https://github.com/caksoylar
  projects:
    # Custom Studio Protocol 対応 ZMK / Zephyr（2026-08-18 時点で pin）
    - name: zmk
      remote: cormoran
      revision: e5c9b6915b56801193e359dd9bad4a167ce0d1b8
      import:
        file: app/west.yml
    - name: zephyr
      remote: cormoran
      revision: 7c6b4cc486ecb41a68d9c2b1def2bb3178fbb826
      clone-depth: 1
      import:
        name-blocklist:
          - ci-tools
          - hal_altera
          - hal_cypress
          - hal_infineon
          - hal_microchip
          - hal_nxp
          - hal_openisa
          - hal_xtensa
          - hal_st
          - hal_ti
          - loramac-node
          - mcuboot
          - mcumgr
          - net-tools
          - openthread
          - edtt
          - trusted-firmware-m

    # DYA Studio Level 2 基盤
    - name: zmk-feature-custom-settings
      remote: cormoran
      revision: c6a7fef3a3be3d3ace5de9a4b0628c6418cd1f3f
    - name: zmk-feature-fast-keymap
      remote: cormoran
      revision: 8dac76de0ba38588ba39ca498910e24f8332bc6b

    # Macro / Combo / 拡張 Physical Layout
    - name: zmk-feature-runtime-macro
      remote: cormoran
      revision: 38530962eb7061b60efcb98e84585cfb1f0cb6de
    - name: zmk-feature-runtime-combo
      remote: cormoran
      revision: d9490e7b5d41c516221d131241009e81740efcee
    - name: zmk-feature-module-physical-layout
      remote: cormoran
      revision: 4f18de45dc27820725d267916b4cdacc0e0b6cf9

    # DYA Studio 対応 PMW3610 / runtime input processor
    - name: zmk-driver-pmw3610-with-custom-studio-rpc
      remote: cormoran
      revision: 5c34ea0eec246a1c986111417cd779b53144629a
    - name: zmk-module-runtime-input-processor
      remote: cormoran
      revision: 43618985f8c9d5457cc333b7ca0733f2d361911e

    # DYA Studio Connection
    - name: zmk-module-ble-management
      remote: cormoran
      revision: 57738cc4fc6ba80e82a7ac57741a0339cb186cd4
    - name: zmk-feature-default-layer
      remote: cormoran
      revision: b25cb5b324da2d9bbc84e1877c775f5b2b7c6845
    - name: zmk-feature-os-detection
      remote: cormoran
      revision: 3052679f645b8fc1997275c2eaa6b86bdd55ca01

    # DYA Studio Settings / Diagnostics
    - name: zmk-module-settings-rpc
      remote: cormoran
      revision: 78f86df9e6c5edaf57bef3ccbd7f360cfdf49291
    - name: zmk-feature-device-info
      remote: cormoran
      revision: 8cedd2dd9f04e19ea5a17b94914dd47a09d8db11
    - name: zmk-feature-watchdog
      remote: cormoran
      revision: 84ad14c6c3645dc40b23f45d08ab45418655f912
    - name: zmk-feature-kscan-diagnostics
      remote: cormoran
      revision: 1432f7fe0cfe903cd7d3c9931ae6bd6f2e1f328e

    # caksoylar/main の pin（rgbled_adapter が xiao_ble_zmk.overlay に対応済み）
    - name: zmk-rgbled-widget
      remote: caksoylar
      revision: e6b467792a1dabef8cfa5c9fd26bfefc9c16662b
  self:
    path: config
```
