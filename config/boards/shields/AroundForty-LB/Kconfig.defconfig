## config/boards/shields/AroundForty-LB/Kconfig.defconfig
```kconfig
if SHIELD_AROUNDFORTY_LB_L

config ZMK_KEYBOARD_NAME
    default "AroundForty-LB_L"

config ZMK_SPLIT
    default y

config ZMK_SPLIT_ROLE_CENTRAL
    default y

endif

if SHIELD_AROUNDFORTY_LB_R

config ZMK_KEYBOARD_NAME
    default "AroundForty-LB_R"

config ZMK_SPLIT
    default y

endif
```

## config/boards/shields/AroundForty-LB/Kconfig.shield
```kconfig
config config SHIELD_AROUNDFORTY_LB_R
    def_bool $(shields_list_contains,AroundForty-LB_R)

config config SHIELD_AROUNDFORTY_LB_L
    def_bool $(shields_list_contains,AroundForty-LB_L)
```
